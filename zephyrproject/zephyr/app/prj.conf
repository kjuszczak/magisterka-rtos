## CMakeLists.txt
```
# SPDX-License-Identifier: Apache-2.0

cmake_minimum_required(VERSION 3.20.0)

set(BOARD nucleo_f207zg)

find_package(Zephyr REQUIRED HINTS $ENV{ZEPHYR_BASE})
project(magisterka)


target_sources(app
               PRIVATE
               src/main.c
               ${PROJECT_SOURCE_DIR}/../../../board_config/src/board_config.c
               ${PROJECT_SOURCE_DIR}/../../../board_config/src/hal_msp.c
               ${PROJECT_SOURCE_DIR}/../../../board_config/src/hal_it.c
               ${PROJECT_SOURCE_DIR}/../../../rhealstone/src/task_switch.c
               ${PROJECT_SOURCE_DIR}/../../../rhealstone/src/task_preemption.c
               ${PROJECT_SOURCE_DIR}/../../../rhealstone/src/interrupt_latency.c
               ${PROJECT_SOURCE_DIR}/../../../rhealstone/src/semaphore_shuffle.c
               ${PROJECT_SOURCE_DIR}/../../../rhealstone/src/deadlock_breaking_time.c
               ${PROJECT_SOURCE_DIR}/../../../rhealstone/src/intertask_msg_latency.c
               ${PROJECT_SOURCE_DIR}/../../../jitter/src/scenario.c
               ${PROJECT_SOURCE_DIR}/../../../mqtt/src/connection_time.c
               src/rtos_portable.c
               src/mqtt_portable.c)
target_include_directories(app
                           PRIVATE
                           ${PROJECT_SOURCE_DIR}/../../../board_config/include
                           ${PROJECT_SOURCE_DIR}/../../../rhealstone/include
                           ${PROJECT_SOURCE_DIR}/../../../jitter/include
                           ${PROJECT_SOURCE_DIR}/../../../mqtt/include
                           ${PROJECT_SOURCE_DIR}/../../../interface/include
                           ${PROJECT_SOURCE_DIR}/../../../include
                           include)
```

## prj.conf
```kconfig
# nothing here
CONFIG_TIMESLICE_PRIORITY=0
CONFIG_TIMESLICE_SIZE=1

CONFIG_NETWORKING=y
CONFIG_NET_SOCKETS=y
CONFIG_NET_TCP=y
CONFIG_NET_LOG=n

CONFIG_NET_IPV6_RA_RDNSS=y
CONFIG_NET_IF_UNICAST_IPV6_ADDR_COUNT=3
CONFIG_NET_IF_MCAST_IPV6_ADDR_COUNT=2

# CONFIG_PRINTK=y
# CONFIG_STDOUT_CONSOLE=y

# Enable IPv6 support
CONFIG_NET_IPV6=n
# Enable IPv4 support
CONFIG_NET_IPV4=y

# Enable the MQTT Lib
CONFIG_MQTT_LIB=y

CONFIG_NET_CONFIG_SETTINGS=y

CONFIG_NET_CONFIG_MY_IPV4_ADDR="192.168.0.20"
CONFIG_NET_CONFIG_MY_IPV4_NETMASK="255.255.255.0"
CONFIG_NET_CONFIG_MY_IPV4_GW="192.168.0.30"
CONFIG_NET_CONFIG_PEER_IPV4_ADDR="192.168.0.30"

CONFIG_MAIN_STACK_SIZE=2048

# For IPv6
CONFIG_NET_BUF_DATA_SIZE=256


CONFIG_ENTROPY_GENERATOR=y
CONFIG_TEST_RANDOM_GENERATOR=y
```

## src/main.c
```c
/*
 * Copyright (c) 2016 Intel Corporation
 *
 * SPDX-License-Identifier: Apache-2.0
 */

#include <zephyr.h>
#include <soc.h>

#include "board_config.h"

#include "test_selection.h"

#include "hal_it.h"

#define MY_STACK_SIZE 500
#define MY_PRIORITY 3

void LedBlinky_Task(void *x, void *y, void *z)
{
    while (true)
    {
        print("Hello World from Zephyr!\r\n");
        toggle_led();
        delay(1000);
    }
}

// K_THREAD_DEFINE(tid_led, MY_STACK_SIZE,
//                 LedBlinky_Task, NULL, NULL, NULL,
//                 MY_PRIORITY, 0, 0);

void main(void)
{
    IRQ_CONNECT(DMA1_Stream1_IRQn, 0, DMA1_Stream1_IRQHandler, 0, 0);
    IRQ_CONNECT(DMA1_Stream3_IRQn, 0, DMA1_Stream3_IRQHandler, 0, 0);
    IRQ_CONNECT(USART3_IRQn, 0, USART3_IRQHandler, 0, 0);
    IRQ_CONNECT(EXTI15_10_IRQn, 0, EXTI15_10_IRQHandler, 0, 0);

    board_config();

    // print("Zephyr OS\n");

    startRtosTest();
}
```

## include/mqtt_config.h
```c
#ifndef MQTT_CONFIG_H
#define MQTT_CONFIG_H

#define ZEPHYR_ADDR		CONFIG_NET_CONFIG_MY_IPV4_ADDR
#define SERVER_ADDR		CONFIG_NET_CONFIG_PEER_IPV4_ADDR
#define SERVER_PORT		1883

#define APP_CONNECT_TIMEOUT_MS	2000
#define APP_SLEEP_MSECS		500

#define APP_CONNECT_TRIES	10

#define APP_MQTT_BUFFER_SIZE	128

#define MQTT_CLIENTID		"zephyr_publisher"

#endif // MQTT_CONFIG_H
```

## src/mqtt_portable.c
```c
#include "mqtt_portable.h"

#include "mqtt_config.h"

#include "board_config.h"

#include <zephyr.h>
#include <net/socket.h>
#include <net/mqtt.h>
#include <random/rand32.h>

#define APP_BMEM
#define APP_DMEM
#define STACK_SIZE 2048
#define THREAD_PRIORITY K_PRIO_PREEMPT(8)

/* INVERSE PRIORITY */
#define TASK_PRIORITY_BASE      3

/* Buffers for MQTT client. */
static APP_BMEM uint8_t rx_buffer[APP_MQTT_BUFFER_SIZE];
static APP_BMEM uint8_t tx_buffer[APP_MQTT_BUFFER_SIZE];

/* The mqtt client struct */
static APP_BMEM struct mqtt_client client_ctx;

/* MQTT Broker details. */
static APP_BMEM struct sockaddr_storage broker;

static APP_BMEM struct zsock_pollfd fds[1];
static APP_BMEM int nfds;

static APP_BMEM bool mqtt_connected;

static uint8_t subTopic[] = "rtos/zephyr/subscribe";
static struct mqtt_topic subs_topic;
static struct mqtt_subscription_list subs_list;

static uint8_t* rtosMqttConnected = NULL;
static uint8_t* rtosMqttPublishedQoS1 = NULL;
static uint8_t* rtosMqttPublishedQoS2 = NULL;

struct mqtt_publish_info {
	const char* topic;
	uint8_t qos;
	uint8_t* payload;
};
struct mqtt_publish_info mqtt_received_info = {
	.topic = NULL,
	.qos = 0,
	.payload = NULL,
};
K_QUEUE_DEFINE(mqtt_publish_queue);
/**/

static int start_app(void);

K_THREAD_DEFINE(app_thread, STACK_SIZE,
		start_app, NULL, NULL, NULL,
		THREAD_PRIORITY, K_USER, -1);
static K_HEAP_DEFINE(app_mem_pool, 1024 * 2);


static int publish();
/***********************************************/

static void prepare_fds(struct mqtt_client *client)
{
	if (client->transport.type == MQTT_TRANSPORT_NON_SECURE) 
    {
		fds[0].fd = client->transport.tcp.sock;
	}
#if defined(CONFIG_MQTT_LIB_TLS)
	else if (client->transport.type == MQTT_TRANSPORT_SECURE) 
    {
		fds[0].fd = client->transport.tls.sock;
	}
#endif

	fds[0].events = ZSOCK_POLLIN;
	nfds = 1;
}

static void clear_fds(void)
{
	nfds = 0;
}

void mqtt_evt_handler(struct mqtt_client *const client,
		      const struct mqtt_evt *evt)
{
	struct mqtt_puback_param puback;
	int len, err;

	switch (evt->type) {
		case MQTT_EVT_CONNACK:
			if (evt->result != 0) {
				print("MQTT connect failed %d\n", evt->result);
				break;
			}
			mqtt_connected = true;
			break;

		case MQTT_EVT_DISCONNECT:
			// print("MQTT client disconnected %d\n", evt->result);
			mqtt_connected = false;
			clear_fds();
			break;

		case MQTT_EVT_SUBACK:
			// print("SUBACK packet id: %u\n", evt->param.suback.message_id);
			break;

		case MQTT_EVT_UNSUBACK:
			// print("UNSUBACK packet id: %u\n", evt->param.suback.message_id);
			break;

		case MQTT_EVT_PUBACK:
			if (evt->result) {
				print("MQTT PUBACK error %d\n", evt->result);
				break;
			}
			*rtosMqttPublishedQoS1 = 1;
			break;

		case MQTT_EVT_PUBREC:
			if (evt->result != 0) {
				print("MQTT PUBREC error %d\n", evt->result);
				break;
			}

			const struct mqtt_pubrel_param rel_param = {
				.message_id = evt->param.pubrec.message_id
			};

			err = mqtt_publish_qos2_release(client, &rel_param);
			if (err != 0) {
				print("Failed to send MQTT PUBREL: %d\n", err);
			}

			break;

		case MQTT_EVT_PUBCOMP:
			if (evt->result != 0) {
				print("MQTT PUBCOMP error %d\n", evt->result);
				break;
			}
			*rtosMqttPublishedQoS2 = 1;
			break;

		case MQTT_EVT_PUBLISH:
			len = evt->param.publish.message.payload.len;
			print("MQTT publish received %d, %d bytes, id: %d, qos: %d\n",
				evt->result,
				len,
				evt->param.publish.message_id,
				evt->param.publish.message.topic.qos);
			break;

		default:
			print("DEFAULT: evt->type:%u\n", evt->type);
			break;
	}
}

static void subscribe(struct mqtt_client *client)
{
	int err;
	/* subscribe */
	subs_topic.topic.utf8 = subTopic;
	subs_topic.topic.size = strlen(subTopic);
	subs_list.list = &subs_topic;
	subs_list.list_count = 1U;
	subs_list.message_id = 1U;

	err = mqtt_subscribe(client, &subs_list);
	if (err) 
	{
		print("Failed on topic\n");
	}
}

static int publish()
{
	struct mqtt_publish_param param;

	param.message.topic.qos = (mqtt_received_info.qos == 2) ? MQTT_QOS_2_EXACTLY_ONCE :
		(mqtt_received_info.qos == 1) ? MQTT_QOS_1_AT_LEAST_ONCE : MQTT_QOS_0_AT_MOST_ONCE;;
	param.message.topic.topic.utf8 = mqtt_received_info.topic;
	param.message.topic.topic.size = strlen(mqtt_received_info.topic);
	param.message.payload.data = mqtt_received_info.payload;
	param.message.payload.len =
			strlen(param.message.payload.data);
	param.message_id = sys_rand32_get();
	param.dup_flag = 0U;
	param.retain_flag = 0U;

	return mqtt_publish(&client_ctx, &param);
}

static void poll_mqtt(void)
{
	if (mqtt_connected)
	{
		mqtt_input(&client_ctx);
	}
}

static void broker_init(void)
{
	struct sockaddr_in *broker4 = (struct sockaddr_in *)&broker;

	broker4->sin_family = AF_INET;
	broker4->sin_port = htons(SERVER_PORT);
	zsock_inet_pton(AF_INET, SERVER_ADDR, &broker4->sin_addr);
}

static void client_init(struct mqtt_client *client)
{
    mqtt_client_init(client);

    broker_init();

    /* MQTT client configuration */
	client->broker = &broker;
	client->evt_cb = mqtt_evt_handler;
	client->client_id.utf8 = (uint8_t *)MQTT_CLIENTID;
	client->client_id.size = strlen(MQTT_CLIENTID);
	client->password = NULL;
	client->user_name = NULL;
	client->protocol_version = MQTT_VERSION_3_1_1;

    /* MQTT buffers configuration */
	client->rx_buf = rx_buffer;
	client->rx_buf_size = sizeof(rx_buffer);
	client->tx_buf = tx_buffer;
	client->tx_buf_size = sizeof(tx_buffer);

    client->transport.type = MQTT_TRANSPORT_NON_SECURE;
}

static int try_to_connect(struct mqtt_client *client)
{
    int rc, i = 0;
    while (i++ < APP_CONNECT_TRIES && !mqtt_connected)
    {
        client_init(client);

        rc = mqtt_connect(client);
		if (rc != 0) 
		{
			delay(APP_SLEEP_MSECS);
			continue;
		}

        prepare_fds(client);

		delay(APP_CONNECT_TIMEOUT_MS);
		mqtt_input(client);

		if (!mqtt_connected)
        {
			mqtt_abort(client);
		}
		else
		{
			*rtosMqttConnected = 1;
		}

		break;
    }

    if (mqtt_connected)
    {
		return 0;
	}

	return -EINVAL;
}

static int start_app(void)
{
	int rc = 0;
	void* mqttData;
	for (;;)
	{
		rc = 0;
		rc = try_to_connect(&client_ctx);
		if (rc)
		{
			print("Error with mqtt app\n");
			return rc;
		}

		mqttData = k_queue_get(&mqtt_publish_queue, K_MSEC(MQTT_POLL_DELAY));
		if (mqttData != NULL)
		{
			mqtt_received_info = *(struct mqtt_publish_info*)mqttData;
			publish();
		}
		poll_mqtt();
	}
    return 0;
}

void initMqtt(uint32_t priority, uint8_t* mqttConnected)
{
    rtosMqttConnected = mqttConnected;

	k_queue_init(&mqtt_publish_queue);
	k_thread_access_grant(k_current_get(), &mqtt_publish_queue);
	k_thread_access_grant(app_thread, &mqtt_publish_queue);

	k_thread_heap_assign(app_thread, &app_mem_pool);
	k_thread_priority_set(app_thread, TASK_PRIORITY_BASE - priority);
	k_thread_start(app_thread);
}

void publishMsg(const char* topic, uint8_t qos, uint8_t* payload, uint8_t* mqttPublished)
{
	static struct mqtt_publish_info mqtt_sent_info;
	if (qos == 1)
	{
		rtosMqttPublishedQoS1 = mqttPublished;
	}
	else if (qos == 2)
	{
		rtosMqttPublishedQoS2 = mqttPublished;
	}

	mqtt_sent_info.topic = topic;
	mqtt_sent_info.qos = qos;
	mqtt_sent_info.payload = payload;
	k_queue_append(&mqtt_publish_queue, (void*)&mqtt_sent_info);
}
```

## src/rtos_portable.c
```c
#include "rtos_portable.h"

#include <zephyr.h>
#include <soc.h>

#define STACK_SIZE              500
#define INITIAL_PRIORITY        0
/* INVERSE PRIORITY */
#define TASK_PRIORITY_BASE      3

TaskFunction tasks[MAX_NUMBER_OF_TASKS] = {NULL, NULL, NULL, NULL, NULL};

/* TASK 1 */
void zephyr_task_1(void *x, void *y, void *z)
{
    tasks[0](NULL);
}
K_THREAD_DEFINE(tid_task_1, STACK_SIZE,
                zephyr_task_1, NULL, NULL, NULL,
                INITIAL_PRIORITY, 0, -1);
/****************************************************************/

/* TASK 2 */
void zephyr_task_2(void *x, void *y, void *z)
{
    tasks[1](NULL);
}
K_THREAD_DEFINE(tid_task_2, STACK_SIZE,
                zephyr_task_2, NULL, NULL, NULL,
                INITIAL_PRIORITY, 0, -1);
/****************************************************************/

/* TASK 3 */
TaskFunction task_3;
void zephyr_task_3(void *x, void *y, void *z)
{
    tasks[2](NULL);
}
K_THREAD_DEFINE(tid_task_3, STACK_SIZE,
                zephyr_task_3, NULL, NULL, NULL,
                INITIAL_PRIORITY, 0, -1);
/****************************************************************/

/* TASK 4 */
TaskFunction task_4;
void zephyr_task_4(void *x, void *y, void *z)
{
    tasks[3](NULL);
}
K_THREAD_DEFINE(tid_task_4, STACK_SIZE,
                zephyr_task_4, NULL, NULL, NULL,
                INITIAL_PRIORITY, 0, -1);
/****************************************************************/

/* TASK 5 */
TaskFunction task_5;
void zephyr_task_5(void *x, void *y, void *z)
{
    tasks[4](NULL);
}
K_THREAD_DEFINE(tid_task_5, STACK_SIZE,
                zephyr_task_5, NULL, NULL, NULL,
                INITIAL_PRIORITY, 0, -1);
/****************************************************************/

const k_tid_t* task_tid[MAX_NUMBER_OF_TASKS] = {&tid_task_1, &tid_task_2, &tid_task_3, &tid_task_4, &tid_task_5};

struct k_sem zephyr_sem;

K_QUEUE_DEFINE(zephyr_queue);

/****************************************************/
K_THREAD_STACK_DEFINE(periodic_task_stack_area, STACK_SIZE);
struct k_work_q periodic_task_work_q;

struct k_work periodic_task_work[MAX_NUMBER_OF_PERIODIC_TASKS];
TaskFunction periodicTask[MAX_NUMBER_OF_PERIODIC_TASKS];

void periodic_task_handler_1(struct k_work *work)
{
    periodicTask[0](NULL);
}

void periodic_task_handler_2(struct k_work *work)
{
    periodicTask[1](NULL);
}

void timer_handler_1(struct k_timer *dummy)
{
    k_work_submit_to_queue(&periodic_task_work_q, &periodic_task_work[0]);
}
void timer_handler_2(struct k_timer *dummy)
{
    k_work_submit_to_queue(&periodic_task_work_q, &periodic_task_work[1]);
}

K_TIMER_DEFINE(timer_1, timer_handler_1, NULL);
K_TIMER_DEFINE(timer_2, timer_handler_2, NULL);

/****************************************************/

void createTask(TaskFunction task, const char *pcName, uint32_t priority, uint8_t taskIndex)
{
    (void) pcName;
    tasks[taskIndex] = task;
    k_thread_priority_set(*task_tid[taskIndex], TASK_PRIORITY_BASE - priority);
    k_thread_access_grant(*task_tid[taskIndex], &zephyr_queue);
    k_thread_start(*task_tid[taskIndex]);
}

void switchTask()
{
    k_yield();
}

void suspendTask(uint8_t taskIndex)
{
    k_thread_suspend(*task_tid[taskIndex]);
}

void resumeTask(uint8_t taskIndex)
{
    k_thread_resume(*task_tid[taskIndex]);
}

void resumeTaskFromIsr(uint8_t taskIndex)
{
    resumeTask(taskIndex);
}

uint8_t createSemaphore()
{
    return k_sem_init(&zephyr_sem, 1, 1) == 0;
}

uint8_t takeSemaphore()
{
    return k_sem_take(&zephyr_sem, K_FOREVER) == 0;
}

uint8_t giveSemaphore()
{
    k_sem_give(&zephyr_sem);
    return 1;
}

uint8_t createQueue(uint8_t queueSize)
{
    k_queue_init(&zephyr_queue);
    return 1;
}

uint8_t sendMsg(void* msg)
{
    k_queue_append(&zephyr_queue, msg);
    return 1;
}

uint8_t receiveMsg(void* msg)
{
    void* temp = k_queue_get(&zephyr_queue, K_FOREVER);
    if (temp != NULL)
    {
        *(uint8_t*)msg = *(uint8_t*)temp;
        return 1;
    }
    else
    {
        return 0;
    }
}

void createPeriodicTask(TaskFunction task, const char *pcName, uint16_t taskPeriod, uint32_t priority, uint8_t taskIndex)
{
    periodicTask[taskIndex] = task;

    if (taskIndex == 0)
    {
        k_work_q_start(&periodic_task_work_q, periodic_task_stack_area,
            K_THREAD_STACK_SIZEOF(periodic_task_stack_area), TASK_PRIORITY_BASE - priority);
        k_work_init(&periodic_task_work[taskIndex], periodic_task_handler_1);
        k_timer_start(&timer_1, K_MSEC(taskPeriod), K_MSEC(taskPeriod));
    }
    else
    {
        k_work_init(&periodic_task_work[taskIndex], periodic_task_handler_2);
        k_timer_start(&timer_2, K_MSEC(taskPeriod), K_MSEC(taskPeriod));
    }
}

void deletePeriodicTask(uint8_t taskIndex)
{
    if (taskIndex == 0)
    {
        k_timer_stop(&timer_1);
    }
    else
    {
        k_timer_stop(&timer_2);
    }
}

void sleepTask(uint32_t time)
{
    k_msleep(time);
}
```
